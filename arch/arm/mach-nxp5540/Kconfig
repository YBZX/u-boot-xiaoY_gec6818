## arch/arm/mach-nxp5540/Kconfig
```kconfig
if ARCH_NXP5540

config NEXELL_COMMON
	bool "Nexell common options"

config NEXELL_ARMV8_COMMON
	bool "Nexell 64-bit common options"
	select ARM64
	select ARMV8_MULTIENTRY
	select NEXELL_COMMON

menu "Board for NXP5540"
source "board/nxp5540/Kconfig"
endmenu

config SYS_SOC
	default "nxp5540"

endif
```

## board/nxp5540/Kconfig
```kconfig
choice
	prompt "Board select"

config TARGET_NXP5540_EVB
	bool "NXP5540_EVB"
	help
	  Support for nxp5540 evb platform.
endchoice

config SYS_VENDOR
	default "nxp5540"

config SYS_CONFIG_NAME
	string "Board header file"
	help
	  This option should contain the base name of board header file.
	  The header file include/configs/<CONFIG_SYS_CONFIG_NAME>.h
	  should be included from include/config.h.

source "board/nxp5540/evb/Kconfig"
```

## board/s5p4418/Kconfig
```kconfig
choice
	prompt "Board select"

config TARGET_S5P4418_DRONE
	bool "S5P4418_DRONE"
	help
	  Support for s5p4418 drone platform.

config TARGET_ARTIK530_RAPTOR
        bool "ARTIK530_RAPTOR"
	help
	  Support for artik530_raptor platform.

config TARGET_S5P4418_AVN_REF
	bool "S5P4418_AVN_REF"
	help
	  Support for s5p4418 avn_ref platform.

config TARGET_NANOPI2
	bool "NANOPI2"
	help
	  Support for FriendlyElec boards based on S5P4418.

config TARGET_S5P4418_NAVI_REF
	bool "S5P4418_NAVI_REF"
	help
	  Support for s5p4418 navi_ref platform.

config TARGET_S5P4418_DAUDIO_REF
	bool "S5P4418_DAUDIO_REF"
	help
	  Support for s5p4418 daudio_ref platform.

config TARGET_S5P4418_SMART_VOICE
	bool "S5P4418_SMART_VOICE"
	help
	  Support for s5p4418 smart_voice platform.

config TARGET_S5P4418_FF_VOICE
	bool "S5P4418_FF_VOICE"
	help
	  Support for s5p4418 farfield_voice platform

config TARGET_S5P4418_ZH_DRAGON
	bool "S5P4418_ZH_DRAGON"
	help
	  Support for s5p4418 zonghong dragon platform.

config TARGET_S5P4418_DAUDIO_COVI
	bool "S5P4418_DAUDIO_COVI"
	help
	  Support for s5p4418 daudio_covi platform.
endchoice

config SYS_VENDOR
	default "s5p4418"

config SYS_CONFIG_NAME
	string "Board header file"
	help
	  This option should contain the base name of board header file.
	  The header file include/configs/<CONFIG_SYS_CONFIG_NAME>.h
	  should be included from include/config.h.

source "board/s5p4418/drone/Kconfig"
source "board/s5p4418/artik530_raptor/Kconfig"
source "board/s5p4418/avn_ref/Kconfig"
source "board/s5p4418/navi_ref/Kconfig"
source "board/s5p4418/daudio_ref/Kconfig"
source "board/s5p4418/smart_voice/Kconfig"
source "board/s5p4418/ff_voice/Kconfig"
source "board/s5p4418/zh_dragon/Kconfig"
source "board/s5p4418/daudio_covi/Kconfig"
source "board/s5p4418/nanopi2/Kconfig"
```

## board/s5p4418/artik530_raptor/Kconfig
```kconfig
if TARGET_ARTIK530_RAPTOR

config SYS_BOARD
	default "artik530_raptor"

config ARTIK_OTA
	bool "ARTIK Update feature"
	help
	  This feature provides OTA(Over-The-Air) function.
	  It updates kernel & modules partition without
	  the need of physical access.
endif
```

## board/s5p4418/nanopi2/Kconfig
```kconfig
if TARGET_NANOPI2

config SYS_BOARD
	default "nanopi2"

config SYS_VENDOR
	default "s5p4418"

config SYS_CONFIG_NAME
	default "s5p4418_nanopi2"

endif
```

## board/s5p6818/Kconfig
```kconfig
choice
	prompt "Board select"

config TARGET_S5P6818_DRONE
	bool "S5P6818_DRONE"
	help
	  Support for s5p6818 drone platform.

config TARGET_ARTIK710_RAPTOR
	bool "ARTIK710_RAPTOR"
	help
	  Support for artik710_raptor platform.

config TARGET_AVN_REF
	bool "AVN_REF"
	help
	  Support for S5P6818 avn ref platform.

config TARGET_KICK_ST
	bool "KICK_ST"
	help
	  Support for S5P6818 kick st platform.

config TARGET_NANOPI3
	bool "NANOPI3"
	help
	  Support for FriendlyElec boards based on S5P6818.

endchoice

config SYS_VENDOR
	default "s5p6818"

config SYS_CONFIG_NAME
	string "Board header file"
	help
	  This option should contain the base name of board header file.
	  The header file include/configs/<CONFIG_SYS_CONFIG_NAME>.h
	  should be included from include/config.h.

source "board/s5p6818/drone/Kconfig"
source "board/s5p6818/avn_ref/Kconfig"
source "board/s5p6818/artik710_raptor/Kconfig"
source "board/s5p6818/kick_st/Kconfig"
source "board/s5p6818/nanopi3/Kconfig"
```

## board/s5p6818/avn_ref/Kconfig
```kconfig
if TARGET_AVN_REF

config SYS_BOARD
	default "avn_ref"

config SYS_VENDOR
	default "s5p6818"

config SYS_CONFIG_NAME
	default "s5p6818_avn_ref"

config S5P6818_FEATURES
	bool
	default y
	select ARM64

endif
```

## board/s5p6818/gec6818/Kconfig
```kconfig
if TARGET_GEC6818

config SYS_BOARD
	default "gec6818"

config SYS_VENDOR
	default "s5p6818"

config SYS_CONFIG_NAME
	default "s5p6818_gec6818"

config S5P6818_FEATURES
	bool
	default y
	select ARM64

endif
```

## board/s5p6818/kick_st/Kconfig
```kconfig
if TARGET_KICK_ST

config SYS_BOARD
	default "kick_st"

config SYS_VENDOR
	default "s5p6818"

config SYS_CONFIG_NAME
	default "s5p6818_kick_st"

config S5P6818_FEATURES
	bool
	default y
	select ARM64

endif
```

## board/s5p6818/nanopi3/Kconfig
```kconfig
if TARGET_NANOPI3

config SYS_BOARD
	default "nanopi3"

config SYS_VENDOR
	default "s5p6818"

config SYS_CONFIG_NAME
	default "s5p6818_nanopi3"

config S5P6818_FEATURES
	bool
	default y
	select ARM64

endif
```

## configs/nxp5540_evb_defconfig
```kconfig
CONFIG_ARM=y
CONFIG_SYS_CONFIG_NAME="nxp5540_evb"
CONFIG_ARCH_NXP5540=y
CONFIG_DM_GPIO=y
CONFIG_SYS_MALLOC_F=y
CONFIG_DEFAULT_DEVICE_TREE="nxp5540-evb"
CONFIG_FIT=y
# CONFIG_CMD_IMI is not set
# CONFIG_CMD_IMLS is not set
# CONFIG_CMD_FLASH is not set
# CONFIG_CMD_FPGA is not set
# CONFIG_CMD_NFS is not set
CONFIG_OF_CONTROL=y
CONFIG_OF_EMBED=y
CONFIG_DM=y
CONFIG_NX_GPIO=y
CONFIG_PINCTRL=y
```

## configs/s5p4418_nanopi2_defconfig
```kconfig
CONFIG_ARM=y
CONFIG_ARCH_NEXELL=y
CONFIG_ARCH_S5P4418=y
CONFIG_TARGET_NANOPI2=y
CONFIG_DM_I2C=y
CONFIG_DM_GPIO=y
CONFIG_DEFAULT_DEVICE_TREE="s5p4418-nanopi2"
CONFIG_FIT=y
# CONFIG_CMD_IMI is not set
# CONFIG_CMD_IMLS is not set
# CONFIG_CMD_FLASH is not set
CONFIG_CMD_I2C=y
CONFIG_CMD_USB=y
# CONFIG_CMD_FPGA is not set
CONFIG_CMD_GPIO=y
# CONFIG_CMD_SETEXPR is not set
# CONFIG_CMD_NET is not set
# CONFIG_CMD_NFS is not set
CONFIG_CMD_FDISK=y
CONFIG_CMD_EXT4_IMG_WRITE=y
CONFIG_CMD_SD_RECOVERY=y
CONFIG_CMD_PMIC=y
CONFIG_CMD_REGULATOR=y
CONFIG_OF_CONTROL=y
CONFIG_OF_EMBED=y
CONFIG_DM=y
CONFIG_NX_GPIO=y
CONFIG_DM_I2C_GPIO=y
CONFIG_SYS_I2C_NEXELL=y
CONFIG_DM_PMIC=y
CONFIG_DM_PMIC_AXP228=y
CONFIG_DM_REGULATOR=y
CONFIG_DM_REGULATOR_AXP228=y
CONFIG_DM_PWM=y
CONFIG_USB=y
CONFIG_DM_USB=y
CONFIG_USB_EHCI_HCD=y
CONFIG_USB_STORAGE=y
CONFIG_DISPLAY_PORT=y
CONFIG_VIDEO_NX=y
CONFIG_VIDEO_NX_RGB=y
CONFIG_VIDEO_NX_LVDS=y
CONFIG_VIDEO_NX_HDMI=y
CONFIG_REGEX=y
CONFIG_ERRNO_STR=y
```

## configs/s5p4418_smart_voice_defconfig
```kconfig
CONFIG_ARM=y
CONFIG_SYS_CONFIG_NAME="s5p4418_smart_voice"
CONFIG_ARCH_NEXELL=y
CONFIG_ARCH_S5P4418=y
CONFIG_CPU_NXP4330=y
CONFIG_TARGET_S5P4418_SMART_VOICE=y
CONFIG_DM_I2C=y
CONFIG_DM_GPIO=y
CONFIG_DEFAULT_DEVICE_TREE="s5p4418-smart-voice"
CONFIG_FIT=y
# CONFIG_CMD_IMI is not set
# CONFIG_CMD_IMLS is not set
# CONFIG_CMD_FLASH is not set
CONFIG_CMD_I2C=y
CONFIG_CMD_USB=y
# CONFIG_CMD_FPGA is not set
CONFIG_CMD_GPIO=y
# CONFIG_CMD_NET is not set
# CONFIG_CMD_NFS is not set
CONFIG_CMD_FDISK=y
CONFIG_CMD_EXT4_IMG_WRITE=y
CONFIG_CMD_CHECK_HW=y
CONFIG_CMD_PMIC=y
CONFIG_CMD_REGULATOR=y
CONFIG_OF_CONTROL=y
CONFIG_OF_EMBED=y
CONFIG_DM=y
CONFIG_NX_GPIO=y
CONFIG_DM_I2C_GPIO=y
CONFIG_SYS_I2C_NEXELL=y
CONFIG_DM_PMIC=y
CONFIG_DM_PMIC_NXE2000=y
CONFIG_DM_REGULATOR=y
CONFIG_DM_REGULATOR_NXE2000=y
CONFIG_DM_PWM=y
CONFIG_USB=y
CONFIG_DM_USB=y
CONFIG_USB_EHCI_HCD=y
CONFIG_USB_STORAGE=y
CONFIG_DISPLAY_PORT=y
CONFIG_VIDEO_NX=y
CONFIG_ERRNO_STR=y
```
